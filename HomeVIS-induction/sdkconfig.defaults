## embedded/room/air-purifier/main/Kconfig.projbuild.example
```kconfig
menu "HomeVIS air purifier"

    config AP_WIFI_SSID
        string "Wi-Fi SSID"
        default "HomeVIS-Devices"

    config AP_WIFI_PASSWORD
        string "Wi-Fi password (empty for open network)"
        default ""

    config AP_MQTT_URI
        string "MQTT broker URI"
        default "mqtt://192.168.4.1:1883"
        help
            Use mqtt://host:port or mqtts://host:port.
            TLS uses the ESP-IDF public CA certificate bundle.

    config AP_MQTT_USERNAME
        string "MQTT username (empty for anonymous)"
        default ""

    config AP_MQTT_PASSWORD
        string "MQTT password"
        default ""

    config AP_MQTT_CLIENT_ID
        string "MQTT client ID (unique per physical board)"
        default "homevis-room-air-purifier"

    config AP_NTP_SERVER
        string "NTP server"
        default "192.168.4.1"

    config AP_RELAY_GPIO
        int "Fan relay GPIO"
        range 0 23
        default 18
        help
            Allowed GPIOs: 0/1/2/3/6/7/18/19/20/21/22/23.
            Must differ from the ADC GPIO.

    config AP_RELAY_ACTIVE_LOW
        bool "Relay is active low"
        default y

    config AP_MQ135_GPIO
        int "MQ135 analog output GPIO (through voltage divider)"
        range 0 6
        default 0
        help
            Allowed ADC GPIOs: 0/1/2/3/6. GPIO4/5 are boot strapping pins.
            Do not connect a 5V analog output directly to the ESP32.

    config AP_MQ135_SUPPLY_MV
        int "MQ135 sensing circuit supply (mV)"
        range 1000 5500
        default 5000
        help
            Sensing circuit Vc, not ADC reference voltage. Current module uses 5V.

    config AP_MQ135_DIVIDER_MILLI
        int "MQ135 AO / ADC voltage multiplier (1000 = x1)"
        range 1000 10000
        default 1000
        help
            Match actual wiring: 1000 for no divider, 2000 for equal resistors.
            This setting does not protect GPIOs. A 5V AO needs a physical divider.
            For AO--Rtop--ADC--Rbottom--GND, use 1000*(Rtop+Rbottom)/Rbottom.

    config AP_MQ135_RL_OHM
        int "MQ135 effective load resistance RL (ohm)"
        range 1 10000000
        default 10000
        help
            Reference code default only; set to the actual effective load.
            Include parallel loading from an external divider when applicable.

    config AP_MQ135_R0_OHM
        int "MQ135 reference resistance R0 (ohm)"
        range 1 10000000
        default 10000
        help
            Reference code default, not a sensor-specific calibration.
            ppm is a CO2-equivalent estimate using 116.6020682*(Rs/R0)^-2.769034857.

    config AP_WARMUP_SEC
        int "Sensor warm-up after boot (seconds)"
        range 1 172800
        default 180
        help
            Operational settling delay, not initial sensor conditioning.
            Winsen specifies over 48 hours of initial preheating.

    config AP_GOOD_RAW
        int "Good air threshold: fan off at or below this ADC count"
        range 1 4093
        default 1500
        help
            Demo threshold, not a health or ppm standard. Calibrate on hardware.

    config AP_BAD_RAW
        int "Bad air threshold: fan on at or above this ADC count"
        range 2 4093
        default 2200
        help
            Must exceed the good threshold and remain below very_bad.
            Intermediate normal values hold fan state.

    config AP_VERY_BAD_RAW
        int "Very bad air threshold (ADC count)"
        range 3 4094
        default 3000
        help
            Must exceed the bad threshold. Reports very_bad and enables
            the fan in auto mode. Demo threshold, not calibrated ppm.

endmenu
```

## embedded/room/room-light/main/Kconfig.projbuild.example
```kconfig
menu "HomeVIS room light"

    config RL_WIFI_SSID
        string "Wi-Fi SSID"
        default "HomeVIS-Devices"

    config RL_WIFI_PASSWORD
        string "Wi-Fi password (empty for open network)"
        default ""

    config RL_MQTT_URI
        string "MQTT broker URI"
        default "mqtt://192.168.4.1:1883"
        help
            Use mqtt://host:port or mqtts://host:port.
            TLS uses the ESP-IDF public CA certificate bundle.

    config RL_MQTT_USERNAME
        string "MQTT username (empty for anonymous)"
        default ""

    config RL_MQTT_PASSWORD
        string "MQTT password"
        default ""

    config RL_MQTT_CLIENT_ID
        string "MQTT client ID (unique per physical board)"
        default "homevis-room-light"

    config RL_NTP_SERVER
        string "NTP server"
        default "192.168.4.1"

    config RL_LED_GPIO
        int "WS2812B strip DIN GPIO"
        range 0 23
        default 4
        help
            ESP32-C6 GPIOs: 0..7/10/11/18..23. Check the board header labels.
            GPIO4/5 are strapping pins: do not override their level during reset.
            USB12/13, UART16/17, strapping8/9/15 and flash pins are reserved.

    config RL_LED_COUNT
        int "Number of WS2812B pixels"
        range 1 120
        default 8
        help
            All pixels share the room light power and brightness.

    config RL_LED_MAX_BRIGHTNESS
        int "White channel value at logical brightness 100 percent (1-255)"
        range 1 255
        default 32
        help
            Scales every pixel's R/G/B channels. MQTT brightness stays 0-100.
            Choose a limit suitable for the LED strip power supply.

endmenu
```

## embedded/wifi-sensing/ap/main/Kconfig.projbuild.example
```kconfig
menu "HomeVIS Local AP"
    config HOMEVIS_AP_SSID
        string "AP SSID"
        default "HomeVIS-Local"

    config HOMEVIS_AP_PASSWORD
        string "AP WPA2 password (8-63 bytes)"
        default ""

    config HOMEVIS_AP_CHANNEL
        int "AP channel (2.4 GHz)"
        range 1 11
        default 6

    config HOMEVIS_AP_MAX_CONNECTIONS
        int "Maximum simultaneous Wi-Fi clients"
        range 1 10
        default 4
        help
            Maximum number of receiver boards connected to this AP.
            Receivers initiate gateway pings and collect CSI themselves.

    config HOMEVIS_RGB_GPIO
        int "WS2812 RGB LED GPIO"
        range 0 30
        default 8
endmenu
```

## embedded/wifi-sensing/ap/sdkconfig.defaults
```kconfig
CONFIG_IDF_TARGET="esp32c6"
# CONFIG_ESP_WIFI_CSI_ENABLED is not set
CONFIG_ESP_WIFI_SOFTAP_SUPPORT=y
CONFIG_PARTITION_TABLE_SINGLE_APP_LARGE=y
CONFIG_ESPTOOLPY_FLASHSIZE_2MB=y
CONFIG_FREERTOS_HZ=1000
CONFIG_ESP_CONSOLE_UART_BAUDRATE=115200
CONFIG_ESP_CONSOLE_SECONDARY_USB_SERIAL_JTAG=y
```

## embedded/wifi-sensing/receiver/main/Kconfig.projbuild.example
```kconfig
menu "HomeVIS CSI receiver"
    config CSI_WIFI_SSID
        string "Wi-Fi SSID"
        default "HomeVIS-Local"

    config CSI_WIFI_PASSWORD
        string "Wi-Fi WPA2 password (8-63 bytes)"
        default ""
endmenu
```

## embedded/wifi-sensing/receiver/sdkconfig.defaults
```kconfig
CONFIG_IDF_TARGET="esp32c6"
CONFIG_ESP_WIFI_CSI_ENABLED=y
CONFIG_ESPTOOLPY_FLASHSIZE_2MB=y
CONFIG_PARTITION_TABLE_SINGLE_APP_LARGE=y
CONFIG_ESP_CONSOLE_UART_BAUDRATE=115200
CONFIG_ESP_CONSOLE_SECONDARY_USB_SERIAL_JTAG=y
CONFIG_FREERTOS_HZ=100
```

## toilet/toilet-light-fan/main/Kconfig.projbuild.example
```kconfig
menu "HomeVIS toilet light and fan"

    config TLF_WIFI_SSID
        string "Wi-Fi SSID"
        default ""

    config TLF_WIFI_PASSWORD
        string "Wi-Fi password (empty for open network)"
        default ""

    config TLF_MQTT_URI
        string "MQTT broker URI"
        default "mqtt://192.168.0.2:1883"
        help
            Use mqtt://host:port or mqtts://host:port.
            TLS uses the ESP-IDF public CA certificate bundle.

    config TLF_MQTT_USERNAME
        string "MQTT username (empty for anonymous)"
        default ""

    config TLF_MQTT_PASSWORD
        string "MQTT password"
        default ""

    config TLF_MQTT_CLIENT_ID
        string "MQTT client ID (unique per physical board)"
        default "homevis-toilet-light-fan"

    config TLF_NTP_SERVER
        string "NTP server"
        default "pool.ntp.org"

    config TLF_LED_GPIO
        int "WS2812B DIN GPIO"
        range 0 10
        default 4
        help
            Use an exposed SuperMini GPIO. GPIO2/8/9 are rejected at boot
            because they are strapping pins. GPIO8 is also a board LED
            on common SuperMini variants. USB GPIO18/19 stay reserved.

    config TLF_LED_COUNT
        int "Number of WS2812B pixels"
        range 1 120
        default 1

    config TLF_LED_MAX_BRIGHTNESS
        int "White channel value at logical brightness 100 percent (1-255)"
        range 1 255
        default 32
        help
            All pixels show white. This caps each R/G/B channel to limit
            light intensity and supply current; MQTT brightness stays 0-100.

    config TLF_RELAY_GPIO
        int "Fan relay IN GPIO"
        range 0 10
        default 5

    config TLF_RELAY_ACTIVE_LOW
        bool "Relay turns on when IN is LOW"
        default y
        help
            Disable for an active-high relay module. Both outputs start OFF.

endmenu
```
