## HomeVIS-induction/sdkconfig.defaults
```kconfig
# ESP32-S3-WROOM-1 N16R8: 16MB flash, 8MB Octal PSRAM.
CONFIG_IDF_TARGET="esp32s3"
CONFIG_ESPTOOLPY_FLASHSIZE_16MB=y
CONFIG_ESP_DEFAULT_CPU_FREQ_MHZ_240=y
CONFIG_FREERTOS_HZ=1000
CONFIG_COMPILER_OPTIMIZATION_PERF=y
CONFIG_SPIRAM=y
CONFIG_SPIRAM_MODE_OCT=y
CONFIG_SPIRAM_SPEED_80M=y
CONFIG_SPIRAM_USE_MALLOC=y
CONFIG_SPIRAM_MALLOC_ALWAYSINTERNAL=4096
CONFIG_SPIRAM_MALLOC_RESERVE_INTERNAL=32768
CONFIG_SPIRAM_IGNORE_NOTFOUND=y
CONFIG_ESP_MAIN_TASK_AFFINITY_CPU1=y
CONFIG_ESP_WIFI_TASK_PINNED_TO_CORE_0=y
CONFIG_MQTT_TASK_CORE_SELECTION_ENABLED=y
CONFIG_MQTT_USE_CORE_0=y
CONFIG_PARTITION_TABLE_CUSTOM=y
CONFIG_PARTITION_TABLE_CUSTOM_FILENAME="partitions.csv"
```

## dummy-data/HomeVIS-induction/main/Kconfig.projbuild.example
```kconfig
# Copy this file to Kconfig.projbuild in the same directory before building.
# Configure Wi-Fi and MQTT credentials locally with idf.py menuconfig.
# Keep credentials out of this example file.

menu "HomeVIS induction dummy configuration"

    config INDUCTION_WIFI_SSID
        string "Wi-Fi SSID"
        default ""

    config INDUCTION_WIFI_PASSWORD
        string "Wi-Fi password (empty for an open network)"
        default ""

    config INDUCTION_MQTT_HOST
        string "MQTT broker hostname or IPv4 address (without mqtt://)"
        default "192.168.0.2"

    config INDUCTION_MQTT_PORT
        int "MQTT TCP port"
        range 1 65535
        default 1883

    config INDUCTION_MQTT_USERNAME
        string "MQTT username (empty for anonymous access)"
        default ""

    config INDUCTION_MQTT_PASSWORD
        string "MQTT password"
        default ""

    config INDUCTION_NTP_SERVER
        string "NTP server (timestamps use Korea time, +09:00)"
        default "pool.ntp.org"

    config INDUCTION_DEFAULT_LEVEL
        int "Heating level for console 2/on / turn_on without level"
        range 1 9
        default 3
        help
            One simulated burner (burner-1), initially off at 25 C.
            No GPIO is driven. Console: 1=off, 2=on (100-120 C),
            3=overheated (150-180 C). Temperature changes every 3 seconds.
            State is sent every 3 seconds and on control or mode changes.

endmenu
```

## dummy-data/HomeVIS-water_purifier/main/Kconfig.projbuild.example
```kconfig
# Copy this file to Kconfig.projbuild in the same directory before building.
# Configure Wi-Fi and MQTT credentials locally with idf.py menuconfig.
# Keep credentials out of this example file.

menu "HomeVIS water purifier dummy configuration"

    config WATER_WIFI_SSID
        string "Wi-Fi SSID"
        default ""

    config WATER_WIFI_PASSWORD
        string "Wi-Fi password (empty for an open network)"
        default ""

    config WATER_MQTT_HOST
        string "MQTT broker hostname or IPv4 address (without mqtt://)"
        default "192.168.0.2"

    config WATER_MQTT_PORT
        int "MQTT TCP port"
        range 1 65535
        default 1883

    config WATER_MQTT_USERNAME
        string "MQTT username (empty for anonymous access)"
        default ""

    config WATER_MQTT_PASSWORD
        string "MQTT password"
        default ""

    config WATER_NTP_SERVER
        string "NTP server (timestamps use Korea time, +09:00)"
        default "pool.ntp.org"

    config WATER_CONSOLE_AMOUNT_ML
        int "Default dispense amount for console on (mL)"
        range 1 5000
        default 250

    config WATER_FLOW_ML_SEC
        int "Simulated dispensing speed (mL per second)"
        range 1 1000
        default 50
        help
            No pump or GPIO is driven. At 50 mL/s, 250 mL completes in 5 s.

endmenu
```

## embedded/dummy-data/HomeVIS-light/main/Kconfig.projbuild.example
```kconfig
# Copy this file to Kconfig.projbuild in the same directory before building.
# Configure Wi-Fi and MQTT credentials locally with idf.py menuconfig.
# Keep credentials out of this example file.

menu "HomeVIS light dummy configuration"

    choice LIGHT_LOCATION
        prompt "Light location (also selects device ID and MQTT topics)"
        default LIGHT_LOCATION_ROOM

        config LIGHT_LOCATION_ROOM
            bool "Room: light-01 (home/room/light/light-01)"

        config LIGHT_LOCATION_TOILET
            bool "Toilet: light-00 (home/toilet/light/light-00)"
    endchoice

    config LIGHT_WIFI_SSID
        string "Wi-Fi SSID"
        default ""

    config LIGHT_WIFI_PASSWORD
        string "Wi-Fi password (empty for an open network)"
        default ""

    config LIGHT_MQTT_HOST
        string "MQTT broker hostname or IPv4 address (without mqtt://)"
        default "192.168.0.2"

    config LIGHT_MQTT_PORT
        int "MQTT TCP port"
        range 1 65535
        default 1883

    config LIGHT_MQTT_USERNAME
        string "MQTT username (empty for anonymous access)"
        default ""

    config LIGHT_MQTT_PASSWORD
        string "MQTT password"
        default ""

    config LIGHT_NTP_SERVER
        string "NTP server (timestamps are emitted in Korea time, +09:00)"
        default "pool.ntp.org"

    config LIGHT_INITIAL_POWER_ON
        bool "Start with the dummy light on"
        default n

    choice LIGHT_LED_TYPE
        prompt "On-board LED type"
        default LIGHT_LED_WS2812

        config LIGHT_LED_WS2812
            bool "Addressable RGB LED (WS2812, ESP32-S3 DevKitC)"

        config LIGHT_LED_GPIO_OUTPUT
            bool "Single-color GPIO LED"
    endchoice

    config LIGHT_LED_GPIO
        int "On-board LED GPIO (DevKitC v1.0: 48, v1.1: 38)"
        range 0 48
        default 48
        help
            Check the board's schematic. ESP32-S3-DevKitC-1 v1.0 uses
            GPIO48 and v1.1 uses GPIO38 for the addressable RGB LED.
            Other S3 boards can use a different GPIO or LED type.

    config LIGHT_LED_BRIGHTNESS
        int "RGB LED white brightness (1-255)"
        depends on LIGHT_LED_WS2812
        range 1 255
        default 16

    config LIGHT_LED_ACTIVE_LOW
        bool "GPIO LED turns on at a low level"
        depends on LIGHT_LED_GPIO_OUTPUT
        default n

endmenu
```

## embedded/gateway/esp32s3-gateway/main/Kconfig.projbuild.example
```kconfig
menu "HomeVIS USB gateway"
    choice GW_TRANSPORT
        prompt "Laptop serial transport"
        default GW_TRANSPORT_UART0
        config GW_TRANSPORT_UART0
            bool "Board COM port (USB-UART to UART0, TX43/RX44)"
        config GW_TRANSPORT_USB_SERIAL_JTAG
            bool "Native USB Serial/JTAG port (GPIO19/20)"
    endchoice
    config GW_SERIAL_BAUD
        int "UART0 data baud rate (must match laptop --baud)"
        range 115200 921600
        default 460800
    config GW_AP_SSID
        string "Appliance Wi-Fi SSID"
        default "HomeVIS-Devices"
    config GW_AP_PASSWORD
        string "Appliance Wi-Fi WPA2 password (8-63 characters)"
        default ""
    config GW_AP_CHANNEL
        int "2.4GHz Wi-Fi channel"
        range 1 11
        default 6
    config GW_MAX_CLIENTS
        int "Maximum Wi-Fi stations and MQTT streams"
        range 6 10
        default 8
    config GW_MQTT_PORT
        int "MQTT proxy listen port"
        range 1024 65535
        default 1883
endmenu
```

## embedded/gateway/esp32s3-gateway/sdkconfig.defaults
```kconfig
CONFIG_IDF_TARGET="esp32s3"
CONFIG_ESPTOOLPY_FLASHSIZE_16MB=y
CONFIG_PARTITION_TABLE_SINGLE_APP_LARGE=y
CONFIG_SPIRAM=y
CONFIG_SPIRAM_MODE_OCT=y
CONFIG_SPIRAM_SPEED_80M=y
CONFIG_ESP_CONSOLE_NONE=y
CONFIG_ESP_CONSOLE_SECONDARY_NONE=y
CONFIG_ESP_WIFI_TASK_PINNED_TO_CORE_0=y
CONFIG_LWIP_TCPIP_TASK_AFFINITY_CPU0=y
CONFIG_LWIP_MAX_SOCKETS=16
CONFIG_FREERTOS_HZ=1000
CONFIG_ESP_MAIN_TASK_STACK_SIZE=8192
CONFIG_COMPILER_OPTIMIZATION_PERF=y
```

## embedded/kitchen/induction/main/Kconfig.projbuild.example
```kconfig
# Public template. Keep credentials empty; local Kconfig.projbuild is ignored.
menu "HomeVIS induction configuration"

    config INDUCTION_NETWORK_ENABLE
        bool "Enable Wi-Fi and MQTT"
        default y

    config INDUCTION_WIFI_SSID
        string "Wi-Fi SSID"
        default ""

    config INDUCTION_WIFI_PASSWORD
        string "Wi-Fi password"
        default ""

    config INDUCTION_MQTT_URI
        string "MQTT broker URI (mqtt://host:1883)"
        default ""

    config INDUCTION_MQTT_USERNAME
        string "MQTT username"
        default ""

    config INDUCTION_MQTT_PASSWORD
        string "MQTT password"
        default ""

    config INDUCTION_DEVICE_ID
        string "Unique MQTT client / device ID"
        default "induction-01"

    config INDUCTION_BURNER_ID
        string "Burner ID"
        default "burner-1"

    config INDUCTION_TOPIC_PREFIX
        string "MQTT topic prefix"
        default "home/kitchen/induction/induction-01"

    config INDUCTION_NTP_SERVER
        string "NTP server"
        default "pool.ntp.org"

    config INDUCTION_LED_MAX_BRIGHTNESS
        int "Maximum LED red channel brightness (12 LEDs)"
        range 9 255
        default 96

    config INDUCTION_DEFAULT_LEVEL
        int "Default level on power-on"
        range 1 9
        default 5

    config INDUCTION_OLED_ENABLE
        bool "Enable SSD1306 128x64 OLED"
        default y

    config INDUCTION_OVERHEAT_ENTER
        int "Overheat enter temperature (C)"
        range 40 350
        default 150

    config INDUCTION_OVERHEAT_EXIT
        int "Overheat exit temperature (C)"
        range 26 149
        default 60

    config INDUCTION_LED_GPIO
        int "External 12-pixel WS2812 data GPIO"
        range 0 23
        default 18

    config INDUCTION_TOUCH_GPIO
        int "External touch module GPIO (active high)"
        range 0 23
        default 19

    config INDUCTION_ENCODER_A_GPIO
        int "Encoder A GPIO"
        range 0 23
        default 20

    config INDUCTION_ENCODER_B_GPIO
        int "Encoder B GPIO"
        range 0 23
        default 21

    config INDUCTION_ENCODER_SW_GPIO
        int "Encoder switch GPIO (active low)"
        range 0 23
        default 22

    config INDUCTION_BUZZER_GPIO
        int "Passive buzzer GPIO"
        range 0 23
        default 23

    config INDUCTION_SDA_GPIO
        int "Shared OLED/GY906 SDA GPIO"
        range 0 23
        default 6

    config INDUCTION_SCL_GPIO
        int "Shared OLED/GY906 SCL GPIO"
        range 0 23
        default 7

endmenu
```

## embedded/kitchen/kitchen-light-hood/main/Kconfig.projbuild.example
```kconfig
menu "HomeVIS kitchen light and hood"

    config KLH_WIFI_SSID
        string "Wi-Fi SSID"
        default "HomeVIS-Devices"

    config KLH_WIFI_PASSWORD
        string "Wi-Fi password (empty for open network)"
        default ""

    config KLH_MQTT_URI
        string "MQTT broker URI"
        default "mqtt://192.168.4.1:1883"
        help
            Use mqtt://host:port or mqtts://host:port.
            TLS uses the ESP-IDF public CA certificate bundle.

    config KLH_MQTT_USERNAME
        string "MQTT username (empty for anonymous)"
        default ""

    config KLH_MQTT_PASSWORD
        string "MQTT password"
        default ""

    config KLH_MQTT_CLIENT_ID
        string "MQTT client ID (unique per physical board)"
        default "homevis-kitchen-light-hood"

    config KLH_NTP_SERVER
        string "NTP server"
        default "192.168.4.1"

    config KLH_LED_GPIO
        int "WS2812B DIN GPIO"
        range 0 23
        default 18
        help
            Supported header pins: GPIO0/1/2/3/6/7/18/19/20/21/22/23.
            Strapping pins, native USB, UART0, flash and variant-specific
            pins are excluded. Choose a pin exposed on your C6 board.

    config KLH_LED_COUNT
        int "Number of WS2812B pixels"
        range 1 120
        default 1

    config KLH_LED_MAX_BRIGHTNESS
        int "White channel value at logical brightness 100 percent (1-255)"
        range 1 255
        default 32
        help
            All pixels show white. This caps each R/G/B channel to limit
            light intensity and supply current; MQTT brightness stays 0-100.

    config KLH_RELAY_GPIO
        int "Hood relay IN GPIO"
        range 0 23
        default 19
        help
            Use a supported header pin different from the LED pin.
            Supported pins: GPIO0/1/2/3/6/7/18/19/20/21/22/23.

    config KLH_RELAY_ACTIVE_LOW
        bool "Relay turns on when IN is LOW"
        default y
        help
            Disable for an active-high relay module. Both outputs start OFF.

endmenu
```

## embedded/kitchen/water-purifier/main/Kconfig.projbuild.example
```kconfig
menu "HomeVIS water purifier"

    config WP_WIFI_SSID
        string "Wi-Fi SSID"
        default "HomeVIS-Devices"

    config WP_WIFI_PASSWORD
        string "Wi-Fi password (empty for open network)"
        default ""

    config WP_MQTT_URI
        string "MQTT broker URI"
        default "mqtt://192.168.4.1:1883"
        help
            Use mqtt://host:port or mqtts://host:port.
            TLS uses the ESP-IDF public CA certificate bundle.

    config WP_MQTT_USERNAME
        string "MQTT username (empty for anonymous)"
        default ""

    config WP_MQTT_PASSWORD
        string "MQTT password"
        default ""

    config WP_MQTT_CLIENT_ID
        string "MQTT client ID (unique per physical board)"
        default "homevis-kitchen-water-purifier"

    config WP_NTP_SERVER
        string "NTP server"
        default "192.168.4.1"

    config WP_LED_GPIO
        int "WS2812B strip DIN GPIO (8 pixels)"
        range 0 23
        default 18
        help
            Allowed GPIOs: 0/1/2/3/6/7/18/19/20/21/22/23. No overlaps.

    config WP_LED_BRIGHTNESS
        int "Red/blue channel brightness (1-255)"
        range 1 255
        default 255

    config WP_SDA_GPIO
        int "OLED SDA GPIO"
        range 0 23
        default 6
        help
            Allowed GPIOs: 0/1/2/3/6/7/18/19/20/21/22/23. No overlaps.

    config WP_SCL_GPIO
        int "OLED SCL GPIO"
        range 0 23
        default 7
        help
            Allowed GPIOs: 0/1/2/3/6/7/18/19/20/21/22/23. No overlaps.

    config WP_TOUCH_1_GPIO
        int "Touch 1 output GPIO"
        range 0 23
        default 0
        help
            Allowed GPIOs: 0/1/2/3/6/7/18/19/20/21/22/23. No overlaps.

    config WP_TOUCH_2_GPIO
        int "Touch 2 output GPIO"
        range 0 23
        default 1
        help
            Allowed GPIOs: 0/1/2/3/6/7/18/19/20/21/22/23. No overlaps.

    config WP_TOUCH_3_GPIO
        int "Touch 3 output GPIO"
        range 0 23
        default 2
        help
            Allowed GPIOs: 0/1/2/3/6/7/18/19/20/21/22/23. No overlaps.

    config WP_TOUCH_4_GPIO
        int "Touch 4 dispense/stop output GPIO"
        range 0 23
        default 3
        help
            Allowed GPIOs: 0/1/2/3/6/7/18/19/20/21/22/23. No overlaps.

    config WP_TOUCH_ACTIVE_LOW
        bool "Touch module outputs are active low (direct/momentary mode)"
        default n

    config WP_OLED_ADDRESS
        hex "SSD1306 I2C address"
        range 0x3c 0x3d
        default 0x3c

    config WP_FLOW_ML_PER_MIN
        int "Simulated dispensing rate (mL/minute)"
        range 1 60000
        default 600
        help
            Controls how long the LEDs stay on. No pump or flow sensor.
            At 600 mL/minute, a 120 mL demonstration lasts 12 seconds.

    config WP_MAX_RUN_SEC
        int "Maximum continuous dispensing time (seconds)"
        range 1 300
        default 120
        help
            Commands requiring more time are rejected, not silently truncated.

endmenu
```
